;~XSF_LANGUAGE: Assembler
;~A
;~+:HEADER
;~T
;-----------------------------------------------------------------------------
;   COPYRIGHT (C) SIEMENS AG 1999
;   AUTOMOTIVE ELEKTRONICS
;   ALLE RECHTE VORBEHALTEN. ALL RIGHTS RESERVED.
;   The reproduction, transmission or use of this document or its
;   contents is not permitted without express written authority.
;   Offenders will be liable for damages. All rights, including rights
;   created by patent grant or registration of a utility model or design,
;   are reserved.
;-----------------------------------------------------------------------------
;   $Workfile:   tbt-hook.cmm  $
;-----------------------------------------------------------------------------
;   $Author:   uid01093  $
;   $Date:   Jan 19 2005 11:07:50  $
;-----------------------------------------------------------------------------
;   $Revision:   1.2  $
;-----------------------------------------------------------------------------
;   Description:        install hooks on practice-stack
;-----------------------------------------------------------------------------
;   Syntax:             run tbt-hook.cmm
;-----------------------------------------------------------------------------
;   Input files:        -
;-----------------------------------------------------------------------------
;   Output files:       -
;-----------------------------------------------------------------------------
;   Environment settings:
;-----------------------------------------------------------------------------
;   Called subscripts:  sys-up.cmm      - called at sysup
;-----------------------------------------------------------------------------
;   CHANGES:
;  
;   $Log:   K:/lib01/4_bmw/GS_CUSNG/ASW/cnf/tbt-hook.cmv  $
 ; 
 ;    Rev 1.2   Jan 19 2005 11:07:50   uid01093
 ; MSx80 C-Sample TriCore
;  
;     Rev 1.2   17 Dec 2004 13:30:52   uid09677
;  TC1766 
;  errata: last 64k of the program flash are not working correctly
;  excluded this part
;  
;     Rev 1.0   Mar 02 2004 13:23:08   uid09677
;  Initial revision.
;  
;  --- copied from: tb_tools/trace32/mpc5xx/tbt-hook.cmm - Rev 1.0 ---
;  
;     Rev 1.0   Jan 26 2004 09:54:12   uid05179
;  Scripts for new MPC5xx-targets and new MPC5xx-mapping
;  
;-----------------------------------------------------------------------------
;~E
;~A
;~+:IMPLEMENTATION
;~T
  ON SYSUP GOSUB
  (
    DO sys-up.cmm
    RETURN
  )
  ON POWERUP GOSUB
  (
    ON ERROR GOTO powerup_failed
    SYStem.UP
    GO
powerup_failed:
    RETURN
  )
  (
     ON ERROR GOTO systemup_failed
     IF STATE.POWER()
        SYStem.Up
systemup_failed:
  )
  WHILE (1==1)
    STOP
ENDDO
;~E
