;~XSF_LANGUAGE: Assembler
;~A
;~+:HEADER
;~T
;-----------------------------------------------------------------------------
;   COPYRIGHT (C) SIEMENS AG 1999
;   AUTOMOTIVE ELEKTRONICS
;   ALLE RECHTE VORBEHALTEN. ALL RIGHTS RESERVED.
;   The reproduction, transmission or use of this document or its
;   contents is not permitted without express written authority.
;   Offenders will be liable for damages. All rights, including rights
;   created by patent grant or registration of a utility model or design,
;   are reserved.
;-----------------------------------------------------------------------------
;   $Workfile:   msx80_onlyflsh_2.cmm  $
;-----------------------------------------------------------------------------
;   $Author:   uid01093  $
;   $Date:   Feb 07 2006 12:15:50  $
;-----------------------------------------------------------------------------
;   $Revision:   1.1  $
;-----------------------------------------------------------------------------
;   Description:       This scripts delets the menu and icons to the toolbar.
;                      Only shortcuts for pure flashing is provided.
;-----------------------------------------------------------------------------
;   Syntax:            run msx80_onlyflsh.cmm
;-----------------------------------------------------------------------------
;   Input files:       -
;-----------------------------------------------------------------------------
;   Output files:      -
;-----------------------------------------------------------------------------
;   Environment settings:
;-----------------------------------------------------------------------------
;   Called subscripts:  init-t32.cmm    - set up TRACE32 (for target)
;                       tbt-hook.cmm    - ON-hooks staying in stack
;                         sys-up.cmm      - called at sysup
;                         init-cpu.cmm  - CPU initialization
;                       flash.cmm       - to flash an elf/s19-file (by menu)
;-----------------------------------------------------------------------------
;   CHANGES:
;  
;   $Log:   K:/LIB01/4_BMW/GS_CUSNG/ASW/CNF/msx80_onlyflsh_2.cmv  $
 ; 
 ;    Rev 1.1   Feb 07 2006 12:15:50   uid01093
 ; new revision with improved trimm and blif handling
 ; 
 ;    Rev 1.0   Feb 07 2006 12:15:06   uid01093
 ; Initial revision.
 ; 
 ;    Rev 1.3   Dec 07 2005 11:27:36   uid01093
 ; new revision with whole blif (0x8000 0700 -- 0x8000 0AFF)
 ; 
 ;    Rev 1.0   Dec 07 2005 11:25:54   uid01093
 ; Initial revision.
 ; 
 ;    Rev 1.3   Aug 23 2004 07:22:26   uid01091
 ; TRIM value backup added (correction)
 ; 
 ;    Rev 1.2   Jul 28 2004 15:39:30   uid01084
 ; TRIM value backup added
 ; 
 ;    Rev 1.1   Jun 23 2004 14:12:04   uid01093
 ; new version for TriCore -> without TRIM_DATA !
;  
;     Rev 1.1   Mar 02 2004 14:12:48   uid09677
;  Adaption to the new practice syntax for line concatination.
;  
;     Rev 1.0   Mar 02 2004 13:23:06   uid09677
;  Initial revision.
;  
;  --- based on tb_tools/trace32/mpc5xx/onlyflsh.cmm - Rev 1.0 ---
;  
;     Rev 1.0   Jan 26 2004 09:54:10   uid05179
;  Scripts for new MPC5xx-targets and new MPC5xx-mapping
;  
;-----------------------------------------------------------------------------
;~E
;~A
;~+:IMPLEMENTATION
;~T
  (
    ON ERROR GOSUB
       RETURN
    IF (VERSION.BUILD()<1146.)
    (
  PRINT %ERROR "The version of TRACE32 you are using is too old for the usage of the Test-Bench-Tools."
  LOCAL &msg
  &msg=                      "The version of TRACE32 you are using is too old"
  &msg="&msg"+CONV.CHAR(10.)+"for the usage of the Test-Bench-Tools."
  &msg="&msg"+CONV.CHAR(10.)
  &msg="&msg"+CONV.CHAR(10.)+"Please contact Mr. Kociper for information"
  &msg="&msg"+CONV.CHAR(10.)+"how to update Lauterbach's TRACE32-software"
  &msg="&msg"+CONV.CHAR(10.)+"(Tel. +49(941)790-7968)."
  &msg="&msg"+CONV.CHAR(10.)
  &msg="&msg"+CONV.CHAR(10.)
  &msg="&msg"+CONV.CHAR(10.)+"ABORTING TRACE32 !!!"
  DIALOG.OK "&msg"
  QUIT
    )
  )
  IF CPUFAMILY()!="TRICORE"
  (
    PRINT %ERROR "The executeable of TRACE32 you are using is NOT useable for these TriCore-scripts."
    LOCAL &msg
    &msg=                      "The executeable of TRACE32 you are using is"
    &msg="&msg"+CONV.CHAR(10.)+"NOT useable for these TriCore-scripts."
    &msg="&msg"+CONV.CHAR(10.)
    &msg="&msg"+CONV.CHAR(10.)+"Please contact Mr. Kociper for information"
    &msg="&msg"+CONV.CHAR(10.)+"which Lauterbach's TRACE32-software to use"
    &msg="&msg"+CONV.CHAR(10.)+"(Tel. +49(941)790-7968)."
    &msg="&msg"+CONV.CHAR(10.)
    &msg="&msg"+CONV.CHAR(10.)
    &msg="&msg"+CONV.CHAR(10.)+"ABORTING TRACE32 !!!"
    DIALOG.OK "&msg"
    QUIT
  )
  PATH ~~~~/
  DO init-t32.cmm
  WINCLEAR
  SETUP.ReSize 51. 10.
  MENU.ReProgram
  (
  menu
  (
    popup "&File"
    (
      menuitem "[:flash]Flash &ELF-file ..." "GOSUB flash_elf"
      menuitem "[:flash]Flash &S19-file ..." "GOSUB flash_s19"
      separator
      menuitem "[:exit]e&Xit" "QUIT"
    )
  )
  toolbar
  (
    separator
    toolitem "Flash ELF-file ..." "11,W,:flash" "GOSUB flash_elf"
    toolitem "Flash S19-file ..." "S3,W,:flash" "GOSUB flash_s19"
    separator
    toolitem "Exit T32" ":exit" "QUIT"
  )
  )
  DO tbt-hook.cmm
ENDDO
flash_s19:
  LOCAL &s19_file &filename_2
  DIALOG.File "*.S19"
  ENTRY %line &s19_file
  IF ("&s19_file"=="")
    RETURN
  IF (STRING.FIND("&s19_file"," "))
  (
    PRINT %ERROR "Sorry: Filenames may not contain spaces '&s19_file'!"
    RETURN
  )
  
;--------------------------------------------------------------
; TRIMVALUE - backup
  PRINT "Saving logistic and trim area"
  data.save.s3record d:\logistic_data.s19 0x80000700--0x80000AFF
  &file_2="d:\logistic_data.s19"
;--------------------------------------------------------------
  
  do flash_2.cmm S19 &s19_file &file_2
  
;--------------------------------------------------------------
; TRIMVALUE - restore
;  PRINT "Restoring logistic and trim area"
;  do flash.cmm ADD-S19 d:\logistic_data.s19
;--------------------------------------------------------------
  
  ENTRY &successful
  if &successful
    DIALOG.OK "DONE."
  RETURN
flash_elf:
  LOCAL &elf_file
  DIALOG.File "*.ELF"
  ENTRY %line &elf_file
  IF ("&elf_file"=="")
    RETURN
  IF (STRING.FIND("&elf_file"," "))
  (
    PRINT %ERROR "Sorry: Filenames may not contain spaces '&elf_file'!"
    RETURN
  )

;--------------------------------------------------------------
; TRIMVALUE - backup
  PRINT "Saving logistic and trim"
  data.save.s3record d:\logistic_data.s19 0x80000700--0x80000AFF
;--------------------------------------------------------------

  do flash.cmm ELF &elf_file
  
;--------------------------------------------------------------
; TRIMVALUE - restore
  PRINT "Restoring logistic and trim"
  do flash.cmm ADD-S19 d:\logistic_data.s19
;--------------------------------------------------------------
  
  ENTRY &successful
  if &successful
    DIALOG.OK "DONE."
  RETURN
;~E
