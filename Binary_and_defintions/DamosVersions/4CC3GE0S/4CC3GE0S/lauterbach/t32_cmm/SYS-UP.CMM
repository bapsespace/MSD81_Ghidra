;~XSF_LANGUAGE: Assembler
;~A
;~+:HEADER
;~T
;-----------------------------------------------------------------------------
;   COPYRIGHT (C) SIEMENS AG 1999
;   AUTOMOTIVE ELEKTRONICS
;   ALLE RECHTE VORBEHALTEN. ALL RIGHTS RESERVED.
;   The reproduction, transmission or use of this document or its
;   contents is not permitted without express written authority.
;   Offenders will be liable for damages. All rights, including rights
;   created by patent grant or registration of a utility model or design,
;   are reserved.
;-----------------------------------------------------------------------------
;   $Workfile:   sys-up.cmm  $
;-----------------------------------------------------------------------------
;   $Author:   uid01093  $
;   $Date:   Jan 19 2005 11:07:50  $
;-----------------------------------------------------------------------------
;   $Revision:   1.2  $
;-----------------------------------------------------------------------------
;   Description:       User's initialization of Trace32 at SYStem.UP-command
;                      
;                      NOTE: This script is intended to be replaced by
;                            an user-specific version.
;-----------------------------------------------------------------------------
;   Syntax:            on sysup gosub
;                        (
;                          do sys-up.cmm
;                          return
;                        )
;                      stop
;-----------------------------------------------------------------------------
;   Input files:       -
;-----------------------------------------------------------------------------
;   Output files:      -
;-----------------------------------------------------------------------------
;   Environment settings:
;-----------------------------------------------------------------------------
;   Called subscripts: init-cpu.cmm             - CPU-Initialization
;-----------------------------------------------------------------------------
;   CHANGES:
;  
;   $Log:   K:/lib01/4_bmw/GS_CUSNG/ASW/cnf/sys-up.cmv  $
 ; 
 ;    Rev 1.2   Jan 19 2005 11:07:50   uid01093
 ; MSx80 C-Sample TriCore
;  
;     Rev 1.2   17 Dec 2004 13:30:50   uid09677
;  TC1766 
;  errata: last 64k of the program flash are not working correctly
;  excluded this part
;  
;     Rev 1.0   Mar 02 2004 13:23:04   uid09677
;  Initial revision.
;  
;  --- based on tb_tools/trace32/mpc5xx/sys-up.cmm - Rev 1.0 ---
;  
;     Rev 1.0   Jan 26 2004 09:54:10   uid05179
;  Scripts for new MPC5xx-targets and new MPC5xx-mapping
;  
;-----------------------------------------------------------------------------
;~E
;~A
;~+:IMPLEMENTATION
;~T
  DO init-cpu.cmm
ENDDO
;~E
