;~XSF_LANGUAGE: Assembler
;~A
;~+:HEADER
;~T
;-----------------------------------------------------------------------------
;   COPYRIGHT (C) SIEMENS AG 1999
;   AUTOMOTIVE ELEKTRONICS
;   ALLE RECHTE VORBEHALTEN. ALL RIGHTS RESERVED.
;   The reproduction, transmission or use of this document or its
;   contents is not permitted without express written authority.
;   Offenders will be liable for damages. All rights, including rights
;   created by patent grant or registration of a utility model or design,
;   are reserved.
;-----------------------------------------------------------------------------
;   $Workfile:   init-t32.cmm  $
;-----------------------------------------------------------------------------
;   $Author:   uid01093  $
;   $Date:   Jan 19 2005 11:07:50  $
;-----------------------------------------------------------------------------
;   $Revision:   1.2  $
;-----------------------------------------------------------------------------
;   Description:        Script to configure TRACE32 at startup-time for TC17XX
;-----------------------------------------------------------------------------
;   Syntax:             do init-t32.cmm
;-----------------------------------------------------------------------------
;   Input files:        -
;-----------------------------------------------------------------------------
;   Output files:       -
;-----------------------------------------------------------------------------
;   Environment settings:
;       OUT:            &isb_addr       - Address of MPC5xx-internal resources
;                       &ext_eras_range - Maximum range for external flash
;                       &ext_flsh_range - Maximum range for external flash
;                       &ext_mrrr_range - Mirror  range of  external flash
;-----------------------------------------------------------------------------
;   Called subscripts:  -
;-----------------------------------------------------------------------------
;   CHANGES:
;  
;   $Log:   K:/lib01/4_bmw/GS_CUSNG/ASW/cnf/init-t32.cmv  $
 ; 
 ;    Rev 1.2   Jan 19 2005 11:07:50   uid01093
 ; MSx80 C-Sample TriCore
;  
;     Rev 1.2   17 Dec 2004 13:30:46   uid09677
;  TC1766 
;  errata: last 64k of the program flash are not working correctly
;  excluded this part
;  
;     Rev 1.0   Mar 02 2004 13:23:04   uid09677
;  Initial revision.
;  
;  --- based on tb_tools/trace32/mpc5xx/init-t32.cmm - Rev 1.0 ---
;  
;     Rev 1.0   Jan 26 2004 09:54:08   uid05179
;  Scripts for new MPC5xx-targets and new MPC5xx-mapping
;  
;-----------------------------------------------------------------------------
;~E
;~A
;~+:IMPLEMENTATION
;~T
  SYStem.BdmClock 5000000.
  SYStem.CPU TC1796
  SYStem.Option TC1796FIX ON
  IF POWERDEBUG()&&POWERNEXUS()
  (
    SYStem.Option BTM OFF
    SYStem.Option DTM OFF
    SYStem.Option OTM OFF
  )
  SYStem.Option DUALPORT ON
  SETUP.IMASKASM ON
  SETUP.IMASKHLL ON
  Break.SELect Program Onchip
  help.bookmark.add N:\trace32\Trainings\Debugger_Trace_TriCore.pdf "TriCore Training" "Andrea Martin"
  help.bookmark.add N:\trace32\Trainings\Debugger_Copperhead.pdf "Copperhead Training" "Andrea Martin"
  help.bookmark.add N:\trace32\Trainings\NEXUS_Copperhead.pdf "Copperhead Nexus Training" "Andrea Martin"
  help.bookmark.add N:\trace32\Trainings\Bdmppc.pdf "PowerPC Training" "Andrea Martin"
  help.bookmark.add N:\trace32\Trainings\Nexusppc.pdf "PowerPC Nexus Training" "Andrea Martin"
ENDDO
;~E
