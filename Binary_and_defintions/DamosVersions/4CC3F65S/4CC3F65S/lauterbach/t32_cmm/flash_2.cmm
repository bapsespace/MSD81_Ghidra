;~XSF_LANGUAGE: Assembler
;~A
;~+:HEADER
;~T
;-----------------------------------------------------------------------------
;   COPYRIGHT (C) SIEMENS AG 1999
;   AUTOMOTIVE ELEKTRONICS
;   ALLE RECHTE VORBEHALTEN. ALL RIGHTS RESERVED.
;   The reproduction, transmission or use of this document or its
;   contents is not permitted without express written authority.
;   Offenders will be liable for damages. All rights, including rights
;   created by patent grant or registration of a utility model or design,
;   are reserved.
;-----------------------------------------------------------------------------
;   $Workfile:   flash_2.cmm  $
;-----------------------------------------------------------------------------
;   $Author:   uid01093  $
;   $Date:   Feb 07 2006 12:16:02  $
;-----------------------------------------------------------------------------
;   $Revision:   1.1  $
;-----------------------------------------------------------------------------
;   Description:        This skript is used to 
;                       1) detect the type of the external flash,
;                       2) configure how to erase/flash the external flash
;                       3) erase all flashs
;                       4) flash ELF-file or various S19-files to the ECU.
;                       
;                       If the filename ist not given as the parameter, it may
;                       be selected by the TRACE 32-file-selection-box.
;                       
;                       No explicit compare is done afterwards, but a failure
;                       during flashing is captured and reported:
;                       - returns true  if successfully.
;                       - returns false if failed or aborted.
;                       
;-----------------------------------------------------------------------------
;   Syntax:             do flash.cmm <S19/ELF/DETECT/...> [<filename> ...]
;-----------------------------------------------------------------------------
;   Input files:        <filename>      - files to be flashed
;                       ~~\...\*.bin    - target oriented flash algorithm
;-----------------------------------------------------------------------------
;   Output files:       -
;-----------------------------------------------------------------------------
;   Environment settings:
;       OUT:            &int_flsh_...   - Description of flashes detected
;                       &ext_flsh_...   
;-----------------------------------------------------------------------------
;   Called subscripts:  -
;-----------------------------------------------------------------------------
;   CHANGES:
; 
;   $Log:   K:/LIB01/4_BMW/GS_CUSNG/ASW/CNF/flash_2.cmv  $
 ; 
 ;    Rev 1.1   Feb 07 2006 12:16:02   uid01093
 ; new revision with improved trimm and blif handling
 ; 
 ;    Rev 1.0   Feb 07 2006 12:15:10   uid01093
 ; Initial revision.
 ; 
 ;    Rev 1.3   Jan 19 2005 11:07:34   uid01093
 ; MSx80 - C-Sample TriCore
;  
;     Rev 1.1   Jun 22 2004 15:05:42   uid09677
;  Increase robustness in case of target not available
;  
;     Rev 1.0   Mar 02 2004 13:23:08   uid09677
;  Initial revision.
; 
;-----------------------------------------------------------------------------
;~E
;~A
;~+:IMPLEMENTATION
;~T
  LOCAL &sub_fct &file_1 &file_2 &filename_3 &filename_4 &filename_5 &filename_6 &filename_7 &filename_8 &eol
  ENTRY &sub_fct &file_1 &file_2 &filename_3 &filename_4 &filename_5 &filename_6 &filename_7 &filename_8 %line &eol
  &sub_fct=STRING.UPR("&sub_fct")
  IF ("&eol"!="")
  (
    PRINT %ERROR "FLASH.CMM: Could not evaluate all filenames given! => ABORTING!"
    ENDDO (0!=0)
  )
  GLOBAL &int_flsh_type &int_flsh_base &int_flsh_size &int_flsh_wdth &int_flsh_mode &int_flsh_offs &trgt_code_addr &trgt_data_addr &trgt_buf_size &int_data_flsh1_base &int_data_flsh2_base &int_data_flsh_size
  IF ("&int_flsh_type"=="")
  (
    IF (CPU()=="TC1796")
    (
      &int_flsh_base=0x80000000
      &int_flsh_size=0x00200000
      &int_flsh_wdth="long"
      &int_flsh_mode="TARGET"
      &int_flsh_offs=0x20000000
      &int_flsh_type="~~/demo/tricore/flash/long/Tc1796.bin"
    )
    ELSE IF (CPU()=="TC1766")
    (
      &int_flsh_base=0x80000000
      &int_flsh_size=0x00178000
      &int_flsh_wdth="long"
      &int_flsh_mode="TARGET"
      &int_flsh_offs=0x20000000
      &int_flsh_type="~~/demo/tricore/flash/long/Tc1796.bin"
      &int_data_flsh1_base=0x8FE00000
      &int_data_flsh2_base=0x8FE10000
      &int_data_flsh_size=0x00004000
    )
    ELSE
      &int_flsh_type="NONE"
  )
  GLOBAL &ext_flsh_type
  IF ("&sub_fct"=="DETECT")
    GOSUB flash_detect &file_1
  ELSE IF ("&ext_flsh_type"=="")
    GOSUB flash_detect
  IF ("&sub_fct"=="DETECT")
    ENDDO (1==1)
  LOCAL &trgt_code_addr &trgt_data_addr &trgt_buf_size
  &trgt_code_addr=0xD4000000
  &trgt_data_addr=0xD0000000
  &trgt_buf_size=0x1000
  (
  ON ERROR GOTO
  (
    DIALOG.OK "An error occured while connecting to" "target for configuring external flash!" "" "Probably target power is off."
    ENDDO (0!=0)
  )
  SYStem.Up
  )
  FLASH.RESET
  IF (CPU()=="TC1796")
  (
  FLASH.Create 1. (&int_flsh_base+0x00000000)--(&int_flsh_base+0x0001ffff) 0x10000 TARGET Long
  FLASH.Create 1. (&int_flsh_base+0x00020000)--(&int_flsh_base+0x0003ffff) 0x20000 TARGET Long
  FLASH.Create 1. (&int_flsh_base+0x00040000)--(&int_flsh_base+0x0007ffff) 0x40000 TARGET Long
  FLASH.Create 1. (&int_flsh_base+0x00080000)--(&int_flsh_base+0x001fffff) 0x80000 TARGET Long
  FLASH.Create 2. (&int_flsh_base+0x0fe00000)--(&int_flsh_base+0x0fe0ffff) 0x10000 TARGET Long
  FLASH.Create 3. (&int_flsh_base+0x0fe10000)--(&int_flsh_base+0x0fe1ffff) 0x10000 TARGET Long
  )
  ELSE IF (CPU()=="TC1766")
  (
  FLASH.Create 1. (&int_flsh_base+0x00000000)--(&int_flsh_base+0x0003ffff) 0x20000 TARGET Long
  FLASH.Create 1. (&int_flsh_base+0x00040000)--(&int_flsh_base+0x0007ffff) 0x40000 TARGET Long
  FLASH.Create 1. (&int_flsh_base+0x00080000)--(&int_flsh_base+0x000fffff) 0x80000 TARGET Long
  FLASH.Create 1. (&int_flsh_base+0x00100000)--(&int_flsh_base+0x0016ffff) 0x70000 TARGET Long
  FLASH.Create 2. (&int_flsh_base+0x0fe00000)--(&int_flsh_base+0x0fe03fff) 0x4000 TARGET Long
  FLASH.Create 3. (&int_flsh_base+0x0fe10000)--(&int_flsh_base+0x0fe13fff) 0x4000 TARGET Long
  )
  IF ("&ext_flsh_type"!="NONE")
  (
  FLASH.Create 128. (&ext_flsh_base)++(&ext_flsh_size-1) &ext_flsh_mode &ext_flsh_wdth
  )
  IF ("&sub_fct"=="CONFIG")
    ENDDO (1==1)
  IF (STRING.MID("&sub_fct",0,4)=="ADD-")
  (
  IF ("&int_flsh_type"!="NONE")
    DATA.COPY &int_flsh_base++(&int_flsh_size-1) VM:&int_flsh_base
  IF ("&ext_flsh_type"!="NONE")
    DATA.COPY (&ext_flsh_base-&ext_flsh_offs)++(&ext_flsh_size-1) VM:(&ext_flsh_base-&ext_flsh_offs)
  )
  ELSE
  (
  sYmbol.RESet
  (
    ON ERROR GOTO
    (
      PRINT %ERROR "An error occured while erasing the flash!"
      DIALOG.OK    "An error occured while erasing the flash!" "" "Probably target power is off."
      ENDDO (0!=0)
    )
  IF ("&int_flsh_type"!="NONE")
  (
  IF ("&int_flsh_mode"=="TARGET")
  (
    FLASH.TARGET &trgt_code_addr &trgt_data_addr &trgt_buf_size &int_flsh_type
  )
  PRINT "Erasing internal flash ..."
  FLASH.Erase 1.
  FLASH.Erase 2.
  FLASH.Erase 3.
  )
  IF ("&ext_flsh_type"!="NONE")
  (
  IF ("&ext_flsh_mode"=="TARGET")
  (
    FLASH.TARGET &trgt_code_addr &trgt_data_addr &trgt_buf_size ~~/demo/tricore/flash/&ext_flsh_wdth/&ext_flsh_type.bin
  )
  PRINT "Erasing external flash ..."
  FLASH.ERASE (&ext_flsh_base)++(&ext_flsh_size-1)
  )
  )
  IF ("&int_flsh_type"!="NONE")
    DATA.SET VM:&int_flsh_base++(&int_flsh_size-1) %Long 0x00000000
  IF ("&ext_flsh_type"!="NONE")
    DATA.SET VM:(&ext_flsh_base-&ext_flsh_offs)++(&ext_flsh_size-1) %Long 0xFFFFFFFF
  IF (CPU()=="TC1766")
    (
      IF ("&int_flsh_type"!="NONE")
      DATA.SET VM:&int_data_flsh1_base++(&int_data_flsh_size-1) %Long 0x00000000
      IF ("&int_flsh_type"!="NONE")
      DATA.SET VM:&int_data_flsh2_base++(&int_data_flsh_size-1) %Long 0x00000000
    )
  )
  IF ("&sub_fct"=="ERASE")
  (
    PRINT "done."
    ENDDO (1==1)
  )
  IF ("&sub_fct"=="")
    ENDDO (1==1)
  LOCAL &data_load_type
  IF ("&sub_fct"=="ELF")||("&sub_fct"=="ADD-ELF")
    &data_load_type="ELF"
  ELSE IF ("&sub_fct"=="S19")||("&sub_fct"=="ADD-S19")
    &data_load_type="S3RECORD"
  ELSE
  (
    PRINT %ERROR "Flash.CMM: Illegal filetype ('&sub_fct')";
    GOTO flsh_cancel
  )
  IF ("&file_1"=="")||!OS.FILE("&file_1")
  (
    LOCAL &file_type
    IF (STRING.MID("&sub_fct",0,4)=="ADD-")
      &file_type=STRING.CUT("&sub_fct",4)
    ELSE
      &file_type="&sub_fct"
    DIALOG.File "*.&file_type"
    ENTRY %line &file_1
    IF ("&file_1"=="")||!OS.FILE("&file_1")
      GOTO flsh_cancel
  )
  LOCAL &pos &path &filename_1
  IF !(STRING.FIND("&file_1","\"))
  (
    PRINT %ERROR "Internal ERROR: Can not extract path from '&file_1'!"
    ENDDO (0!=0)
  )
  &pos=STRING.LEN("&file_1")
  WHILE (STRING.MID("&file_1",&pos,1)!="\")
    &pos=&pos-1
  &path=STRING.MID("&file_1",0,&pos)
  &filename_1=STRING.CUT("&file_1",&pos+1)
  PRINT "Loading files to virtual memory ..."
  MMU.Create (&int_flsh_base+&int_flsh_offs)++(&int_flsh_size-1) &int_flsh_base
  MMU.ON
  IF ("&filename_1"!="")
    DATA.LOAD.&data_load_type &path\&filename_1 /VM /Long /NosYmbol
  IF ("&filen_2"!="")
    DATA.LOAD.&data_load_type &file_2 /VM /Long /NosYmbol
  IF ("&filename_3"!="")
    DATA.LOAD.&data_load_type &path\&filename_3 /VM /Long /NosYmbol
  IF ("&filename_4"!="")
    DATA.LOAD.&data_load_type &path\&filename_4 /VM /Long /NosYmbol
  IF ("&filename_5"!="")
    DATA.LOAD.&data_load_type &path\&filename_5 /VM /Long /NosYmbol
  IF ("&filename_6"!="")
    DATA.LOAD.&data_load_type &path\&filename_6 /VM /Long /NosYmbol
  IF ("&filename_7"!="")
    DATA.LOAD.&data_load_type &path\&filename_7 /VM /Long /NosYmbol
  IF ("&filename_8"!="")
    DATA.LOAD.&data_load_type &path\&filename_8 /VM /Long /NosYmbol
  MMU.Reset
  LOCAL &flash_successful
  &flash_successful=(0!=0)
  (
    ON ERROR GOTO flash_failed
  IF ("&int_flsh_type"!="NONE")
  (
  IF ("&int_flsh_mode"=="TARGET")
    FLASH.TARGET &trgt_code_addr &trgt_data_addr &trgt_buf_size &int_flsh_type
  PRINT "Programming internal flash ..."
  FLASH.Program 1.
  TDIAG DATA.COPY VM:&int_flsh_base++(&int_flsh_size-1) &int_flsh_base
  IF (CPU()=="TC1766")
    (
     FLASH.Program 2.
     TDIAG DATA.COPY VM:&int_data_flsh1_base++(&int_data_flsh_size-1) &int_data_flsh1_base
     FLASH.Program 3.
     TDIAG DATA.COPY VM:&int_data_flsh2_base++(&int_data_flsh_size-1) &int_data_flsh2_base
    )
  FLASH.Program OFF
  )
  ELSE
    PRINT "No internal flash availible."
  IF ("&ext_flsh_type"!="NONE")
  (
  IF ("&ext_flsh_mode"=="TARGET")
  (
    FLASH.TARGET &trgt_code_addr &trgt_data_addr &trgt_buf_size ~~/demo/tricore/flash/&ext_flsh_wdth/&ext_flsh_type.bin
  )
  PRINT "Programming external flash ..."
  FLASH.Program 128.
  DATA.COPY VM:(&ext_flsh_base-&ext_flsh_offs)++(&ext_flsh_size-1) &ext_flsh_base
  FLASH.Program OFF
  )
  &flash_successful=(1==1)
  )
flash_failed:
  FLASH.Program OFF
  IF &flash_successful
  (
    PRINT        "Successfully flashed."
  )
  ELSE
  (
    PRINT %ERROR "Flashing failed!"
    DIALOG.OK    "Flashing failed!"
  )
ENDDO &flash_successful
flsh_cancel:
  PRINT "Flashing canceled!"
ENDDO (0!=0)
flash_detect:
  ON ERROR GOTO
  (
    PRINT %ERROR "Flash.CMM: Error detecting external flash!"
    RETURN
  )
  LOCAL &mode
  ENTRY %line &mode
  IF SIMULATOR()
  (
    GLOBAL &ext_flsh_type
    &ext_flsh_type="SIMULATOR"
    RETURN
  )
  IF ("&cpu"!="TC1796")
  (
    GLOBAL &ext_flsh_type
    &ext_flsh_type="NONE"
    RETURN
  )
  IF !SYSTEM.UP()
    SYStem.Up
  IF RUN()
    BREAK
  GLOBAL &ext_flsh_type &ext_flsh_base &ext_flsh_size &ext_flsh_wdth &ext_flsh_mode &ext_flsh_offs
  &ext_flsh_type="NONE"
  &ext_flsh_base=0xA1000000
  &ext_flsh_size=""
  &ext_flsh_wdth=""
  &ext_flsh_mode=""
  &ext_flsh_offs=0x20000000
  Data.Set &ext_flsh_base            %l 0x000000f0
  Data.Set &ext_flsh_base+(0x555<<2) %l 0x000000aa
  Data.Set &ext_flsh_base+(0x2aa<<2) %l 0x00000055
  Data.Set &ext_flsh_base+(0x555<<2) %l 0x00000090
  IF (DATA.LONG(a:&ext_flsh_base)==0x00000001)&&(DATA.LONG(a:&ext_flsh_base+4)==0x0000007E)
  (
    Data.Set &ext_flsh_base          %l 0x000000f0
    &ext_flsh_type="AM29BDD"
    &ext_flsh_size=0x00200000
    &ext_flsh_wdth="LONG"
    GOTO flsh_detect_done
  )
  Data.Set &ext_flsh_base            %l 0x00f000f0
  Data.Set &ext_flsh_base+(0x555<<2) %l 0x00aa00aa
  Data.Set &ext_flsh_base+(0x2aa<<2) %l 0x00550055
  Data.Set &ext_flsh_base+(0x555<<2) %l 0x00900090
  IF (DATA.LONG(a:&ext_flsh_base)==0x00010001)
  (
    Data.Set &ext_flsh_base            %l 0x00f000f0
    &ext_flsh_type="AM29LV100"
    &ext_flsh_size=0x00200000
    &ext_flsh_wdth="LONG"
    GOTO flsh_detect_done
  )
  Data.Set &ext_flsh_base            %w 0x00f0
  Data.Set &ext_flsh_base+(0x555<<1) %w 0x00aa
  Data.Set &ext_flsh_base+(0x2aa<<1) %w 0x0055
  Data.Set &ext_flsh_base+(0x555<<1) %w 0x0090
  IF (DATA.WORD(a:&ext_flsh_base)==0x0001)
  (
    Data.Set &ext_flsh_base            %w 0x00f0
    &ext_flsh_type="AM29LV100"
    &ext_flsh_size=0x00200000
    &ext_flsh_wdth="WORD"
    GOTO flsh_detect_done
  )
  Data.Set &ext_flsh_base %l 0xffffffff
  Data.Set &ext_flsh_base %l 0x00000090
  IF (DATA.LONG(a:&ext_flsh_base)==0x00000020)
  (
    Data.Set &ext_flsh_base %l 0xffffffff
    &ext_flsh_type="M58BW016"
    &ext_flsh_size=0x00200000
    &ext_flsh_wdth="LONG"
    GOTO flsh_detect_done
  )
  PRINT "Flash.CMM: No known external flash found."
RETURN
flsh_detect_done:
  IF (STRING.UPR("&mode")=="HOST")
  (
    &ext_flsh_mode="&ext_flsh_type"
    PRINT "External flash detected as '&ext_flsh_type' with Host-based routine."
  )
  ELSE IF (STRING.UPR("&mode")=="TARGET")||("&mode"=="")
  (
    &ext_flsh_mode="TARGET"
    PRINT "External flash detected as '&ext_flsh_type' with Target-based routine."
  )
  ELSE
  (
    PRINT %ERROR "Flash.CMM: Illegal mode-keyword ('&mode')!"
  )
RETURN
;~E
