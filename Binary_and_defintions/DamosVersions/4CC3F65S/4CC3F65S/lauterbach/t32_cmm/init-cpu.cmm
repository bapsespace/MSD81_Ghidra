;~XSF_LANGUAGE: Assembler
;~A
;~+:HEADER
;~T
;-----------------------------------------------------------------------------
;   COPYRIGHT (C) SIEMENS AG 1999
;   AUTOMOTIVE ELEKTRONICS
;   ALLE RECHTE VORBEHALTEN. ALL RIGHTS RESERVED.
;   The reproduction, transmission or use of this document or its
;   contents is not permitted without express written authority.
;   Offenders will be liable for damages. All rights, including rights
;   created by patent grant or registration of a utility model or design,
;   are reserved.
;-----------------------------------------------------------------------------
;   $Workfile:   init-cpu.cmm  $
;-----------------------------------------------------------------------------
;   $Author:   uid01093  $
;   $Date:   Feb 17 2005 12:08:58  $
;-----------------------------------------------------------------------------
;   $Revision:   1.3  $
;-----------------------------------------------------------------------------
;   Description:        Initialize the MPC5xx at system.up-time
;-----------------------------------------------------------------------------
;   Syntax:             on sysup gosub
;                         (
;                           do init-cpu.cmm
;                           return
;                         )
;                       stop
;-----------------------------------------------------------------------------
;   Input files:        -
;-----------------------------------------------------------------------------
;   Output files:       -
;-----------------------------------------------------------------------------
;   Environment settings:
;       OUT:            &cpu            - derivate's name
;-----------------------------------------------------------------------------
;   Called subscripts:  flash.cmm    - to detect type of external flash
;                                         (called with mode: DETECT)
;-----------------------------------------------------------------------------
;   CHANGES:
;  
;   $Log:   K:/LIB01/4_BMW/GS_CUSNG/ASW/CNF/init-cpu.cmv  $
 ; 
 ;    Rev 1.3   Feb 17 2005 12:08:58   uid01093
 ; MSx80 C-Sample TriCore update 1
;  
;     Rev 1.3   17 Dec 2004 13:30:44   uid09677
;  TC1766 
;  errata: last 64k of the program flash are not working correctly
;  excluded this part
;  
;     Rev 1.1   Jun 22 2004 15:06:26   uid09677
;  CPU detection added (TC1766/TC1796)
;  
;     Rev 1.0   Mar 02 2004 13:23:10   uid09677
;  Initial revision.
;  
;  --- based on tb_tools/trace32/mpc5xx/init-5xx.cmm - Rev 1.0 ---
;  
;-----------------------------------------------------------------------------
;~E
;~A
;~+:IMPLEMENTATION
;~A
;~+:Exported function
;~L
  ON ERROR GOTO init_cpu_end
;~A
;~+:Determine derivate
;~T
  GLOBAL &cpu

;~L
  IF ("&cpu"!="")&&(!SIMULATOR())
  (

;~T
  ; Check if an already detected processor has changed
  ;

;~L
  LOCAL &cpu_reg
  &cpu_reg=data.long(D:0xF0000074)>>8
 
  IF ((&cpu_reg!=0x8A)&&("&cpu"=="TC1796"))||((&cpu_reg!=0x8B)&&("&cpu"=="TC1766"))||(CPU()!="&cpu")
  (

;~T
  DIALOG.YESNO "WARNING --- WARNING --- WARNING" "" "The target processor has changed!" "" "Do you want to try to reinitialize the target?"
  LOCAL &result
  ENTRY &result
  IF (&result)
  (
    &cpu=""
    &ext_flsh_type=""
  )

;~E
;~T
  )

;~E
;~T
  )

;~L
  IF ("&cpu"=="")
  (

;~T
  ; Detect connected processor
  ;
;~T
  ON SYSUP NOTHING              ; do NOT execute SYSUP-hook while reconnecting in that block

;~T
  SYStem.CPU TC1796             ; system.cpu needs to be defined to get data in
  SYStem.Option TC1796FIX ON    ; (only required for A steps)
  SYStem.Up                     ; system.cpu may force system down
;~L
  IF SIMULATOR()
  (

;~T
  DIALOG
  (
    HEADER "Select TriCore-derivate"
    POS 1. 0.25 20.
    TEXT "Please select the TriCore-derivate"
    POS 1. 1.00 20.
    TEXT "to be used in the simulator:"
    POS 2. 2.25 18.
    init_cpu_sim_dialog.TC1766: CHOOSEBOX "TC1766"  "CONTINUE"
    init_cpu_sim_dialog.TC1796: CHOOSEBOX "TC1796"  "CONTINUE"
    CLOSE                                           "CONTINUE"
    ; CLOSE
    ; (
    ;   PRINT %ERROR "You must select an derivate to continue!"
    ; )
  )
  STOP
  IF DIALOG.BOOLEAN(init_cpu_sim_dialog.TC1766)
    &cpu="TC1766"
  ELSE IF DIALOG.BOOLEAN(init_cpu_sim_dialog.TC1796)
    &cpu="TC1796"
  ELSE ; Dialog was exited by CLOSE
    &cpu="TC1796"
  DIALOG.END

;~E
;~L
  )
  ELSE 
  (

;~T
  LOCAL &cpu_reg
  &cpu_reg=data.long(D:0xF0000074)>>8
  
  IF &cpu_reg==0x8A
    &cpu="TC1796"
  ELSE IF &cpu_reg==0x8B
    &cpu="TC1766"

;~E
;~T
  )

;~T
  IF "&cpu"==""
  (
    PRINT %ERROR "TriCore-detection failed!"
    DIALOG.OK    "TriCore-detection failed!"
  )
  ELSE
  (
    PRINT "&cpu detected"
    SYStem.CPU &cpu             ; set detected TriCore-CPU-type
    SYStem.Up                   ; system.cpu may force system down
  )

;~E
;~T
  ; deactivate the watchdog necessary @ A-step
  
  Data.EPILOG.SEQUENCE Set 0xf0000024 %l (d.l(d:0xf0000024)|0x00000008)
  Data.EPILOG.ON
;~T
 )

;~E
;~A
;~+:Set up processor
;~T

  IF "&cpu"=="TC1796"
    (
      Data.Set 0f8000080 %l 0A0000803             ; ADDR_SEL0
      Data.Set 0f80000C0 %l 000820000             ; BUSCON0
      Data.Set 0f8000100 %l 023FF0100             ; BUSAP0
      Data.Set 0f8000010 %l 00000FF68             ; EBUCON
    )
  ELSE IF "&cpu"=="TC1766"
    (
      DO noextflash.cmm
;      D.S D:0xF0000040 %LONG 0x1200F84          ; reduced clockspeed for programming
    )
;~T
 
  SYStem.Option TC1796FIX ON                    ; (only required for A steps)

  Data.Set 0f7E1FD00 %l 000000017               ; DBGSVR
    
  Data.Set 0f0000470 %l 0ff000100               ; set break switch (set bit 8 in MCDBBS)
                                                ; (only required when using a "Debug Interface";
                                                ;  otherwise extevt occurs)
  
  Data.Set D:0xF000047C %LE %LONG 0x03          ; For ocds level2 trace call

;~T
  GLOBAL &int_flsh_type &ext_flsh_base
  
  IF ("&int_flsh_type"=="NONE")&&("&ext_flsh_base"!="")
    Register.Set PC &ext_flsh_base

;~E
;~E
;~T
init_cpu_end:
  ON ERROR
;~T
ENDDO
;~E
;~A
;~+:Private functions
;~T

;~E
;~E
